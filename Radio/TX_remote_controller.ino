//________________________________________________________________________________________________
//                                  КНОПКИ
//‾‾‾‾‾‾‾‾‾‾‾‾‾‾‾‾‾‾‾‾‾‾‾‾‾‾‾‾‾‾‾‾‾‾‾‾‾‾‾‾‾‾‾‾‾‾‾‾‾‾‾‾‾‾‾‾‾‾‾‾‾‾‾‾‾‾‾‾‾‾‾‾‾‾‾‾‾‾‾‾‾‾‾‾‾‾‾‾‾‾‾‾‾‾‾‾‾‾‾‾‾‾‾‾‾‾‾‾‾‾‾‾‾‾‾‾‾‾‾‾
#define BTN1_PIN 19 // А5
#define BTN2_PIN 18 // А4
#include <GyverButton.h>
//________________________________________________________________________________________________
//                                  РАДИО
//‾‾‾‾‾‾‾‾‾‾‾‾‾‾‾‾‾‾‾‾‾‾‾‾‾‾‾‾‾‾‾‾‾‾‾‾‾‾‾‾‾‾‾‾‾‾‾‾‾‾‾‾‾‾‾‾‾‾‾‾‾‾‾‾‾‾‾‾‾‾‾‾‾‾‾‾‾‾‾‾‾‾‾‾‾‾‾‾‾‾‾‾‾‾‾‾‾‾‾‾‾‾‾‾‾‾‾‾‾‾‾‾‾‾‾‾‾‾‾‾
#include <SPI.h>                                                     // Подключаем библиотеку SPI
#include <nRF24L01.h>                                                // Подключаем библиотеку nRF24L01
#include <RF24.h>                                                    // Подключаем библиотеку RF24
//________________________________________________________________________________________________
//                            БИБЛИОТЕКА ДИСПЛЕЯ
//‾‾‾‾‾‾‾‾‾‾‾‾‾‾‾‾‾‾‾‾‾‾‾‾‾‾‾‾‾‾‾‾‾‾‾‾‾‾‾‾‾‾‾‾‾‾‾‾‾‾‾‾‾‾‾‾‾‾‾‾‾‾‾‾‾‾‾‾‾‾‾‾‾‾‾‾‾‾‾‾‾‾‾‾‾‾‾‾‾‾‾‾‾‾‾‾‾‾‾‾‾‾‾‾‾‾‾‾‾‾‾‾‾‾‾‾‾‾‾‾
#include <U8g2lib.h>                                                 // Подключаем библиотеку U8g2lib
//________________________________________________________________________________________________
//                       ПЕРЕМЕННЫЕ/ПОДКЛЮЧЕНИЕ ДИСПЛЕЙ
//‾‾‾‾‾‾‾‾‾‾‾‾‾‾‾‾‾‾‾‾‾‾‾‾‾‾‾‾‾‾‾‾‾‾‾‾‾‾‾‾‾‾‾‾‾‾‾‾‾‾‾‾‾‾‾‾‾‾‾‾‾‾‾‾‾‾‾‾‾‾‾‾‾‾‾‾‾‾‾‾‾‾‾‾‾‾‾‾‾‾‾‾‾‾‾‾‾‾‾‾‾‾‾‾‾‾‾‾‾‾‾‾‾‾‾‾‾‾‾‾
U8G2_ST7565_ERC12864_1_4W_SW_SPI u8g2(U8G2_R0, /* scl=*/ 4, /* si=*/ 5, /* cs=*/ 6, /* rs=*/ 7, /* rse=*/ 8);  // Переворот
//________________________________________________________________________________________________
//                              ПЕРЕДАЧА КНОПКИ
//‾‾‾‾‾‾‾‾‾‾‾‾‾‾‾‾‾‾‾‾‾‾‾‾‾‾‾‾‾‾‾‾‾‾‾‾‾‾‾‾‾‾‾‾‾‾‾‾‾‾‾‾‾‾‾‾‾‾‾‾‾‾‾‾‾‾‾‾‾‾‾‾‾‾‾‾‾‾‾‾‾‾‾‾‾‾‾‾‾‾‾‾‾‾‾‾‾‾‾‾‾‾‾‾‾‾‾‾‾‾‾‾‾‾‾‾‾‾‾‾
GButton butt1(BTN1_PIN);                                             // Присваиваем кнопке имя
GButton butt2(BTN2_PIN);                                             // Присваиваем кнопке имя
//________________________________________________________________________________________________
//                              ПОДКЛЮЧЕНИЕ РАДИО
//‾‾‾‾‾‾‾‾‾‾‾‾‾‾‾‾‾‾‾‾‾‾‾‾‾‾‾‾‾‾‾‾‾‾‾‾‾‾‾‾‾‾‾‾‾‾‾‾‾‾‾‾‾‾‾‾‾‾‾‾‾‾‾‾‾‾‾‾‾‾‾‾‾‾‾‾‾‾‾‾‾‾‾‾‾‾‾‾‾‾‾‾‾‾‾‾‾‾‾‾‾‾‾‾‾‾‾‾‾‾‾‾‾‾‾‾‾‾‾‾
int data[1];                                                         // Создаём массив для передачи данных
RF24 radio(9, 10);                                                   // Указываем номера выводов nRF24L01+ (CE, CSN)
//________________________________________________________________________________________________
//                             ПЕРЕМЕННЫЕ ДАТЧИКОВ
//‾‾‾‾‾‾‾‾‾‾‾‾‾‾‾‾‾‾‾‾‾‾‾‾‾‾‾‾‾‾‾‾‾‾‾‾‾‾‾‾‾‾‾‾‾‾‾‾‾‾‾‾‾‾‾‾‾‾‾‾‾‾‾‾‾‾‾‾‾‾‾‾‾‾‾‾‾‾‾‾‾‾‾‾‾‾‾‾‾‾‾‾‾‾‾‾‾‾‾‾‾‾‾‾‾‾‾‾‾‾‾‾‾‾‾‾‾‾‾‾
int t;                     // передается из void в void             // Целое число для температуры
int h;                     // передается из void в void             // Целое число для влажности
int ackData[2] = {t, h};                                                     // Массив для приёма
bool count;


//________________________________________________________________________________________________
//====================================VOID SETUP==================================================
//‾‾‾‾‾‾‾‾‾‾‾‾‾‾‾‾‾‾‾‾‾‾‾‾‾‾‾‾‾‾‾‾‾‾‾‾‾‾‾‾‾‾‾‾‾‾‾‾‾‾‾‾‾‾‾‾‾‾‾‾‾‾‾‾‾‾‾‾‾‾‾‾‾‾‾‾‾‾‾‾‾‾‾‾‾‾‾‾‾‾‾‾‾‾‾‾‾‾‾‾‾‾‾‾‾‾‾‾‾‾‾‾‾‾‾‾‾‾‾‾
void setup() {
  Serial.begin(9600);
//________________________________________________________________________________________________
//                                  НАСТРОЙКИ РАДИО
//‾‾‾‾‾‾‾‾‾‾‾‾‾‾‾‾‾‾‾‾‾‾‾‾‾‾‾‾‾‾‾‾‾‾‾‾‾‾‾‾‾‾‾‾‾‾‾‾‾‾‾‾‾‾‾‾‾‾‾‾‾‾‾‾‾‾‾‾‾‾‾‾‾‾‾‾‾‾‾‾‾‾‾‾‾‾‾‾‾‾‾‾‾‾‾‾‾‾‾‾‾‾‾‾‾‾‾‾‾‾‾‾‾‾‾‾‾‾‾‾
  delay(2000);                               // Ждем 2с
  radio.begin();                             // Инициируем работу nRF24L01+
  //radio.setAutoAck(false);
  radio.setChannel(120);                     // Указываем канал передачи (от 0 до 126)
  radio.setDataRate (RF24_1MBPS);            // Указываем скорость передачи (250KBPS, 1MBPS, 2MBPS)
  radio.setPALevel(RF24_PA_HIGH);            // Указываем мощность передатчика (MIN=-18dBm, LOW=-12dBm, HIGH=-6dBm, MAX=0dBm)
  radio.openReadingPipe(1, 0xF0F0F0F166);    // Идентификатор для получения данных
  radio.openWritingPipe(0xF0F0F0F066);       // Задаем идентификатор для передачи данных данных
  radio.flush_tx();                          // Очистка памяти от отправленных данных

//________________________________________________________________________________________________
//                               НАСТРОЙКИ ДИСПЛЕЯ
//‾‾‾‾‾‾‾‾‾‾‾‾‾‾‾‾‾‾‾‾‾‾‾‾‾‾‾‾‾‾‾‾‾‾‾‾‾‾‾‾‾‾‾‾‾‾‾‾‾‾‾‾‾‾‾‾‾‾‾‾‾‾‾‾‾‾‾‾‾‾‾‾‾‾‾‾‾‾‾‾‾‾‾‾‾‾‾‾‾‾‾‾‾‾‾‾‾‾‾‾‾‾‾‾‾‾‾‾‾‾‾‾‾‾‾‾‾‾‾‾
  u8g2.begin();
  u8g2.setContrast (65);
  u8g2.enableUTF8Print();
}


//________________________________________________________________________________________________
//=================================VOID YIELD=====================================================
//‾‾‾‾‾‾‾‾‾‾‾‾‾‾‾‾‾‾‾‾‾‾‾‾‾‾‾‾‾‾‾‾‾‾‾‾‾‾‾‾‾‾‾‾‾‾‾‾‾‾‾‾‾‾‾‾‾‾‾‾‾‾‾‾‾‾‾‾‾‾‾‾‾‾‾‾‾‾‾‾‾‾‾‾‾‾‾‾‾‾‾‾‾‾‾‾‾‾‾‾‾‾‾‾‾‾‾‾‾‾‾‾‾‾‾‾‾‾‾‾
void yield() {
  task_controller();                                                 // код кнопок
  task_info();                                                       // код приёма
}

//________________________________________________________________________________________________
//==================================VOID LOOP=====================================================
//‾‾‾‾‾‾‾‾‾‾‾‾‾‾‾‾‾‾‾‾‾‾‾‾‾‾‾‾‾‾‾‾‾‾‾‾‾‾‾‾‾‾‾‾‾‾‾‾‾‾‾‾‾‾‾‾‾‾‾‾‾‾‾‾‾‾‾‾‾‾‾‾‾‾‾‾‾‾‾‾‾‾‾‾‾‾‾‾‾‾‾‾‾‾‾‾‾‾‾‾‾‾‾‾‾‾‾‾‾‾‾‾‾‾‾‾‾‾‾‾
void loop() {
  task_display();                                                    // код дисплей
}

//________________________________________________________________________________________________
//                                 КОД КНОПОК
//‾‾‾‾‾‾‾‾‾‾‾‾‾‾‾‾‾‾‾‾‾‾‾‾‾‾‾‾‾‾‾‾‾‾‾‾‾‾‾‾‾‾‾‾‾‾‾‾‾‾‾‾‾‾‾‾‾‾‾‾‾‾‾‾‾‾‾‾‾‾‾‾‾‾‾‾‾‾‾‾‾‾‾‾‾‾‾‾‾‾‾‾‾‾‾‾‾‾‾‾‾‾‾‾‾‾‾‾‾‾‾‾‾‾‾‾‾‾‾‾
void task_controller() {
  butt1.tick(); butt2.tick();                                        // проверка состояния кнопок

  //Serial.println(F("Проверяю кнопочки: "));                           // ПРИНТ
  if (butt1.isHolded()) {
    Serial.println(F("влево"));                                    // ПРИНТ
    data[0] = 9;                                                     // Записываем значение 1 в массив data
    radio.write(data, 1);
  }
  else if (butt2.isHolded()) {
    //Serial.println(F("вправо"));                                   // ПРИНТ
    data[0] = 5;                                                     // Записываем значение 2 в массив data
    radio.write(data, 1);
  }
  else if (butt1.isClick() || butt2.isClick()) {
    Serial.println(F("Стоп"));             // ПРИНТ
    data[0] = 1;                                                     // Записываем значение 1 в массив data
    radio.write(data, 1);
    count = 1;
    //Serial.println(count);              // ПРИНТ

  }
}

//________________________________________________________________________________________________
//                      КОД ПОЛУЧЕНИЯ ДАННЫХ С ДАТЧИКОВ
//‾‾‾‾‾‾‾‾‾‾‾‾‾‾‾‾‾‾‾‾‾‾‾‾‾‾‾‾‾‾‾‾‾‾‾‾‾‾‾‾‾‾‾‾‾‾‾‾‾‾‾‾‾‾‾‾‾‾‾‾‾‾‾‾‾‾‾‾‾‾‾‾‾‾‾‾‾‾‾‾‾‾‾‾‾‾‾‾‾‾‾‾‾‾‾‾‾‾‾‾‾‾‾‾‾‾‾‾‾‾‾‾‾‾‾‾‾‾‾‾
void task_info() {
  if (count == 1) {
    radio.startListening();
    if (radio.available()) {
        radio.read(&ackData, 4);                          // Читаем данные из буфера в массив ackData указывая сколько всего байт может поместиться в массив.
        t = ackData[0];
        h = ackData[1];
        //Serial.print(F("Температура: ")); Serial.println(t);           // ПРИНТ ЭТОГО ТРИППЕРА
        //Serial.print(F("Влажность  :   ")); Serial.println(h);           // ПРИНТ ЭТОГО ТРИППЕРА
        //Serial.print(F("Пришло байт:  ")); Serial.println(sizeof(ackData)); // ПРИНТ ЭТОГО ТРИППЕРА
        count = 0;
        radio.stopListening();
      }
  }
}


//________________________________________________________________________________________________
//                           КОД ВЫВОДА НА ДИСПЛЕЙ
//‾‾‾‾‾‾‾‾‾‾‾‾‾‾‾‾‾‾‾‾‾‾‾‾‾‾‾‾‾‾‾‾‾‾‾‾‾‾‾‾‾‾‾‾‾‾‾‾‾‾‾‾‾‾‾‾‾‾‾‾‾‾‾‾‾‾‾‾‾‾‾‾‾‾‾‾‾‾‾‾‾‾‾‾‾‾‾‾‾‾‾‾‾‾‾‾‾‾‾‾‾‾‾‾‾‾‾‾‾‾‾‾‾‾‾‾‾‾‾‾
void task_display() {
  //Serial.println(F("Обновляю экран"));              // ПРИНТ ЭТОГО ТРИППЕРА
  u8g2.firstPage();                                                  // Первая страница
  do {
    u8g2.setFont(u8g2_font_6x13B_t_cyrillic);
    u8g2.setFont(u8g2_font_6x10_tf);
    u8g2.setCursor(0, 12); u8g2.print(F("Observatory:"));               // строка 1
    u8g2.setCursor(0, 25); u8g2.print(F("DNT 'Pryaniki v2.0'"));        // строка 2
    u8g2.setFont(u8g2_font_cu12_t_cyrillic);
    u8g2.setCursor(0, 42); u8g2.print(F("Температура: ")); u8g2.print(t); u8g2.print(F("*С"));   // строка 3
    u8g2.setCursor(2, 60); u8g2.print(F("Влажность:   ")); u8g2.print(h); u8g2.print(F("%"));    // строка 4
  }
  while (u8g2.nextPage());                                         // Вторая страница
  delay(500);                                                     // Время перелистывания
}