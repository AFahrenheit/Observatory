
#define EB_DEB_TIME 50      // таймаут гашения дребезга кнопки (кнопка)
//____________________________________________________________________________________________
//                                 БИБЛИОТЕКИ РАДИО
//‾‾‾‾‾‾‾‾‾‾‾‾‾‾‾‾‾‾‾‾‾‾‾‾‾‾‾‾‾‾‾‾‾‾‾‾‾‾‾‾‾‾‾‾‾‾‾‾‾‾‾‾‾‾‾‾‾‾‾‾‾‾‾‾‾‾‾‾‾‾‾‾‾‾‾‾‾‾‾‾‾‾‾‾‾‾‾‾‾‾‾‾‾‾‾‾‾‾‾‾‾‾‾‾‾‾‾‾‾‾‾‾‾‾‾
#include <SPI.h>                                       // Подключаем библиотеку SPI
#include <nRF24L01.h>                                  // Подключаем библиотеку nRF24L01
#include <RF24.h>                                      // Подключаем библиотеку RF24
//____________________________________________________________________________________________
//                               БИБЛИОТЕКИ ДАТЧИКОВ
//‾‾‾‾‾‾‾‾‾‾‾‾‾‾‾‾‾‾‾‾‾‾‾‾‾‾‾‾‾‾‾‾‾‾‾‾‾‾‾‾‾‾‾‾‾‾‾‾‾‾‾‾‾‾‾‾‾‾‾‾‾‾‾‾‾‾‾‾‾‾‾‾‾‾‾‾‾‾‾‾‾‾‾‾‾‾‾‾‾‾‾‾‾‾‾‾‾‾‾‾‾‾‾‾‾‾‾‾‾‾‾‾‾‾‾
//#include <Arduino.h>
//#include <Wire.h>
//#include "Adafruit_SHT31.h"                            // датчик темп и влажности
//____________________________________________________________________________________________
//                          ПЕРЕМЕННЫЕ/ПОДКЛЮЧЕНИЕ ДАТЧИКОВ
//‾‾‾‾‾‾‾‾‾‾‾‾‾‾‾‾‾‾‾‾‾‾‾‾‾‾‾‾‾‾‾‾‾‾‾‾‾‾‾‾‾‾‾‾‾‾‾‾‾‾‾‾‾‾‾‾‾‾‾‾‾‾‾‾‾‾‾‾‾‾‾‾‾‾‾‾‾‾‾‾‾‾‾‾‾‾‾‾‾‾‾‾‾‾‾‾‾‾‾‾‾‾‾‾‾‾‾‾‾‾‾‾‾‾‾
//Adafruit_SHT31 sht31 = Adafruit_SHT31();               // датчик темп и влажности
//int t;                                               // Целое число для температуры
//int h;                                               // Целое число для влажности
//int ackData[1];                             // Массив передаваемых данных
//____________________________________________________________________________________________
//                                     МОТОР
//‾‾‾‾‾‾‾‾‾‾‾‾‾‾‾‾‾‾‾‾‾‾‾‾‾‾‾‾‾‾‾‾‾‾‾‾‾‾‾‾‾‾‾‾‾‾‾‾‾‾‾‾‾‾‾‾‾‾‾‾‾‾‾‾‾‾‾‾‾‾‾‾‾‾‾‾‾‾‾‾‾‾‾‾‾‾‾‾‾‾‾‾‾‾‾‾‾‾‾‾‾‾‾‾‾‾‾‾‾‾‾‾‾‾‾
//#define GS_FAST_PROFILE количество
#include <GyverStepper2.h>
GStepper2<STEPPER2WIRE> stepper(200, 5, 4, 3);                      // 200 драйвер steps, +pul, +dir, +enable

// Если звездочка 60мм диаметра (дл.ок. 0,1884м), а упорное кольцо 2,42м (дл.ок 8,8м), то
// выходит звездочка делает 46,7 оборотов за 1 полный круг купола,
// редуктор 36 к 1, 200 шагов на оборот мотора.

int32_t incoming = 0;
//____________________________________________________________________________________________
//                                     РАДИО
//‾‾‾‾‾‾‾‾‾‾‾‾‾‾‾‾‾‾‾‾‾‾‾‾‾‾‾‾‾‾‾‾‾‾‾‾‾‾‾‾‾‾‾‾‾‾‾‾‾‾‾‾‾‾‾‾‾‾‾‾‾‾‾‾‾‾‾‾‾‾‾‾‾‾‾‾‾‾‾‾‾‾‾‾‾‾‾‾‾‾‾‾‾‾‾‾‾‾‾‾‾‾‾‾‾‾‾‾‾‾‾‾‾‾‾
int32_t data[2];                                           // Массив для приёма данных 2
RF24 radio(9, 10);                                     // Указываем номера выводов nRF24L01+ (CE, CSN)
//____________________________________________________________________________________________
//                                     ДЖОЙСТИК
//‾‾‾‾‾‾‾‾‾‾‾‾‾‾‾‾‾‾‾‾‾‾‾‾‾‾‾‾‾‾‾‾‾‾‾‾‾‾‾‾‾‾‾‾‾‾‾‾‾‾‾‾‾‾‾‾‾‾‾‾‾‾‾‾‾‾‾‾‾‾‾‾‾‾‾‾‾‾‾‾‾‾‾‾‾‾‾‾‾‾‾‾‾‾‾‾‾‾‾‾‾‾‾‾‾‾‾‾‾‾‾‾‾‾‾
#include <GyverJoy.h>
GyverJoy jx(2);   // джойстик на пине A2 (указываются пины АЦП)

#include <EncButton.h>
//EncButton<EB_TICK, 2> button(INPUT_PULLUP);
//EncButton button(2, INPUT_PULLUP);  // кнопка на D2
Button button(2);
bool count_click = 0;                                  // счётчик нажатий кнопки джойстика
uint8_t count_sec = 0;                                 // счётчик секунд бездействия

bool count = 0;                                       // счётчик включения датчика темп/вл
int16_t joy_speed_value = 2000; // скорость вращения мотора с джойтика                (ТРОГАЛ)


void setup() {
//____________________________________________________________________________________________
//                                   VOID SETUP
//‾‾‾‾‾‾‾‾‾‾‾‾‾‾‾‾‾‾‾‾‾‾‾‾‾‾‾‾‾‾‾‾‾‾‾‾‾‾‾‾‾‾‾‾‾‾‾‾‾‾‾‾‾‾‾‾‾‾‾‾‾‾‾‾‾‾‾‾‾‾‾‾‾‾‾‾‾‾‾‾‾‾‾‾‾‾‾‾‾‾‾‾‾‾‾‾‾‾‾‾‾‾‾‾‾‾‾‾‾‾‾‾‾‾‾
  Serial.begin(9600);
  //Serial.println("1 Общий запуск");
  //stepper.setAcceleration(300);                        // ускорение (умолчание 300) (ТРОГАЛ)
  stepper.autoPower(true);                             // автовыключение питания драйвера
  //stepper.setMaxSpeed(2500);         // установка макс. скорости в шагах/сек        (ТРОГАЛ)
//  stepper.disable();
  //____________________________________________________________________________________________
  //                                   РАБОТА РАДИО
  //‾‾‾‾‾‾‾‾‾‾‾‾‾‾‾‾‾‾‾‾‾‾‾‾‾‾‾‾‾‾‾‾‾‾‾‾‾‾‾‾‾‾‾‾‾‾‾‾‾‾‾‾‾‾‾‾‾‾‾‾‾‾‾‾‾‾‾‾‾‾‾‾‾‾‾‾‾‾‾‾‾‾‾‾‾‾‾‾‾‾‾‾‾‾‾‾‾‾‾‾‾‾‾‾‾‾‾‾‾‾‾‾‾‾‾
  delay(2000);                                               // Ждем 2с
  radio.begin();                                             // Инициируем работу nRF24L01+
  radio.setChannel(120);                                     // Указываем канал передачи (от 0 до 126)
  radio.setRetries(10, 50);                                  // Кол-во попыток и время между попытками
  radio.setDataRate (RF24_1MBPS);                            // Указываем скорость передачи (250KBPS, 1MBPS, 2MBPS)
  radio.setPALevel(RF24_PA_MAX);                            // Указываем мощность передатчика (MIN=-18dBm, LOW=-12dBm, HIGH=-6dBm, MAX=0dBm)
  radio.openReadingPipe(1, 0xF0F0F0F066);                    // Идентификатор для получения данных
  radio.openWritingPipe(0xF0F0F0F166);                       // Идентификатор для отправки данных
  radio.startListening();                                    // Начать прослушивание эфира
  //Serial.println("2 Радио");
//--------------------------------------------------------------------------------------------
//                        НАСТРОЙКА/КАЛИБРОВКА ДАТЧИКОВ
//--------------------------------------------------------------------------------------------
//  while (!Serial)
//    delay(10);                                               // Задержка для теста
//    //Serial.print("Тест");                           // ПРИНТ ЭТОГО ТРИППЕРА
//  if (! sht31.begin(0x44)) {                                 // 0x45 для альтернативного i2c адрес
//    //Serial.println("Couldn't find SHT31");        // ПРИНТ ЭТОГО ТРИППЕРА
//    while (1) delay(1);
//  }
//____________________________________________________________________________________________
//                                     ДЖОЙСТИК
//‾‾‾‾‾‾‾‾‾‾‾‾‾‾‾‾‾‾‾‾‾‾‾‾‾‾‾‾‾‾‾‾‾‾‾‾‾‾‾‾‾‾‾‾‾‾‾‾‾‾‾‾‾‾‾‾‾‾‾‾‾‾‾‾‾‾‾‾‾‾‾‾‾‾‾‾‾‾‾‾‾‾‾‾‾‾‾‾‾‾‾‾‾‾‾‾‾‾‾‾‾‾‾‾‾‾‾‾‾‾‾‾‾‾‾
  jx.calibrate();   // калибровка нуля при запуске
  jx.deadzone(30);  // мёртвая зона
  //Serial.println("3 Калибровка джойстика");
  //jx.exponent(GJ_SQUARE);  // экспонента для плавности
}
void loop() {
//____________________________________________________________________________________________
//                                   VOID LOOP
//‾‾‾‾‾‾‾‾‾‾‾‾‾‾‾‾‾‾‾‾‾‾‾‾‾‾‾‾‾‾‾‾‾‾‾‾‾‾‾‾‾‾‾‾‾‾‾‾‾‾‾‾‾‾‾‾‾‾‾‾‾‾‾‾‾‾‾‾‾‾‾‾‾‾‾‾‾‾‾‾‾‾‾‾‾‾‾‾‾‾‾‾‾‾‾‾‾‾‾‾‾‾‾‾‾‾‾‾‾‾‾‾‾‾‾

  task_motor();
  task_temp_hum();
  task_joy();
}
void task_motor() {
//____________________________________________________________________________________________
//                                   КОД МОТОРА
//‾‾‾‾‾‾‾‾‾‾‾‾‾‾‾‾‾‾‾‾‾‾‾‾‾‾‾‾‾‾‾‾‾‾‾‾‾‾‾‾‾‾‾‾‾‾‾‾‾‾‾‾‾‾‾‾‾‾‾‾‾‾‾‾‾‾‾‾‾‾‾‾‾‾‾‾‾‾‾‾‾‾‾‾‾‾‾‾‾‾‾‾‾‾‾‾‾‾‾‾‾‾‾‾‾‾‾‾‾‾‾‾‾‾‾
  stepper.tick();                                            // Проверка состояния мотора
  //Serial.println("4 Проверка мотора");

  if (stepper.ready()) {
      //Serial.println("Приехал, слушаем.");
      radio.startListening();
  }

  if (radio.available()) {                                   // Если в буфере поступили данные
      radio.read(data, sizeof(data));                                     //sizeof(data) Считываем данные с массива data и задаем количество считываемых байт
      //Serial.print("Пришел массив:");Serial.println(data[0]);

//   МОТОР
    if (data[0]) {
        motor();
    }

//   ПУЛЬТ
//    switch (data[1]) {                                       // Если присланый массив data[0] состоит.....
//        case 9: stepper.setSpeed(2000);                      // Поворачиваем двигатель влево
//            //Serial.println(F("Влево"));                // ПРИНТ ЭТОГО ТРИППЕРА
//            break;                                               // брейк
//        case 5: stepper.setSpeed(-2000);                     // Поворачиваем двигатель вправо
//            //Serial.println(F("Вправо"));               // ПРИНТ ЭТОГО ТРИППЕРА
//            break;                                               // брейк
//        case 1: stepper.stop();                                // Останавливаем двигатель
//            //Serial.println(F("Стоп"));                 // ПРИНТ ЭТОГО ТРИППЕРА
//            delay(20);
//            count += 1;                                          // счёт включения отправки данных датчика
//            break;                                               // брейк
//    }
  }
}
void motor() {
    radio.stopListening();
    //Serial.print("Пришла информация: "); Serial.print(data[0]); Serial.print("соток  "); Serial.print(float(data[0] / 100.0)); Serial.println("град."); // приходящая информация
    //incoming = data[0] * 0.02;                     // градусы в передаче, нужно /100 по факту
    //stepper.setTargetDeg(incoming, RELATIVE);     // градусы

    //Serial.print("Пришла информация: "); Serial.print(data[0]); Serial.print("шагов  "); Serial.print(float(data[0] / (36.0*2.0))); Serial.println("град."); // *1.8 приходящая информация
    //data[0] = 1800 * 2;
    incoming = - data[0];                              //   шаги
    //Serial.print("incoming: "); Serial.println(incoming);
    stepper.setTargetDeg(incoming, RELATIVE);          // шаги

}
void task_temp_hum() {

  //Serial.println("5 Проверка датчиков");
//____________________________________________________________________________________________
//                      КОД СБОРА И ОТПРАВКИ ДАННЫХ С ДАТЧИКОВ
//‾‾‾‾‾‾‾‾‾‾‾‾‾‾‾‾‾‾‾‾‾‾‾‾‾‾‾‾‾‾‾‾‾‾‾‾‾‾‾‾‾‾‾‾‾‾‾‾‾‾‾‾‾‾‾‾‾‾‾‾‾‾‾‾‾‾‾‾‾‾‾‾‾‾‾‾‾‾‾‾‾‾‾‾‾‾‾‾‾‾‾‾‾‾‾‾‾‾‾‾‾‾‾‾‾‾‾‾‾‾‾‾‾‾‾
//  if (count == 1) {
//    t = sht31.readTemperature();                                    // температура в массив
//    h = sht31.readHumidity();                                    // влажность в массив
//    radio.stopListening();
//    //Serial.println(F("Готовлюсь отправлять"));                 // ПРИНТ ЭТОГО ТРИППЕРА
//    ackData[0] = t;                                     // температура в массив
//    ackData[1] = h;                                    // влажность в массив
//    //Serial.print("Температура  : "); Serial.println(ackData[0]);                    // ПРИНТ ЭТОГО ТРИППЕРА
//    //Serial.print("Влажность    :   "); Serial.println(ackData[1]);                    // ПРИНТ ЭТОГО ТРИППЕРА
//    //Serial.print("Занимает байт:    "); Serial.println(sizeof(ackData));
//    radio.write(ackData, 4);            // ответочка с данными массива
//    //delay(20);                                         // Задержка в 0.02сек
//    //Serial.println(F("Отправлено!"));                 // ПРИНТ ЭТОГО ТРИППЕРА
//    count = 0;
//    radio.startListening();
//  }
}
void task_joy() {
//____________________________________________________________________________________________
//                                   КОД ДЖОЙСТИКА
//‾‾‾‾‾‾‾‾‾‾‾‾‾‾‾‾‾‾‾‾‾‾‾‾‾‾‾‾‾‾‾‾‾‾‾‾‾‾‾‾‾‾‾‾‾‾‾‾‾‾‾‾‾‾‾‾‾‾‾‾‾‾‾‾‾‾‾‾‾‾‾‾‾‾‾‾‾‾‾‾‾‾‾‾‾‾‾‾‾‾‾‾‾‾‾‾‾‾‾‾‾‾‾‾‾‾‾‾‾‾‾‾‾‾‾
  button.tick();                       // опрос кнопки
  //Serial.println("6 Проверка джойстика");

  if (button.click()){
    radio.stopListening();
//    stepper.enable();
    count_click += 1;
    //Serial.println(F("Джойстик вкл."));
    while (count_click == 1){
      stepper.tick();
      jx.tick();
      //Serial.println(jx.value());
      if (jx.value() > 1) {
        count_sec = 0;
        stepper.setSpeed(joy_speed_value);
        //Serial.println(F("Влево!"));     // включение движения мотора влево
      }
      else if (jx.value() < -1) {
        count_sec = 0;
        stepper.setSpeed(- joy_speed_value);
        //Serial.println(F("Вправо!"));    // включение движения мотора вправo
      }
      else {
        stepper.stop();
        //Serial.print("Стоп");
        delay(1000);
        count_sec += 1;                // включение счётчика при бездействии
        //Serial.println(count_sec);

        if (count_sec > 1) {        // выключение пульта
          //Serial.println(F("Джойстик выкл."));
          count_click = 0;
          count_sec = 0;
//          stepper.disable();
          radio.startListening();
          break;
        }
      }
    }
  }
}
